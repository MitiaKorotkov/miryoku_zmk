// Copyright 2021 Manna Harbour
// https://github.com/manna-harbour/miryoku

#include "../miryoku/custom_config.h"
#include "../miryoku/mapping/44/fuji44.h"
#include "../miryoku/miryoku.dtsi"

// Cyrillic (RU/YCUKEN) support.
//
// ZMK/HID sends raw US-QWERTY key positions, not characters - the actual
// glyph is decided by the host OS keyboard layout. The host is already
// configured with a "us,ru" layout toggled by Alt+Shift (grp:alt_shift_toggle
// in Hyprland), so switching languages only requires:
//   1. An extra layer (RUS, index 10, appended after Miryoku's 10 layers
//      BASE..FUN) that sends plain positional US-QWERTY codes instead of
//      Colemak, since the host's "ru" layout expects standard QWERTY
//      physical positions to produce the correct Cyrillic letters.
//   2. A way to flip both the ZMK layer and the host's active layout at
//      once, so one physical action keeps them in sync.
//
// Toggled by a combo on the spare left thumb key (the 4th thumb per side
// that Miryoku's core layers always leave unbound) plus A, rather than
// spending a dedicated key.
//
// Russian has 33 letters, 4 more than fit in the 30 positions that mirror
// Latin Q..P/A../Z../. Rather than needing dedicated key positions for
// those, the outer pinky columns on the top and home rows (also otherwise
// idle) are reused to send the plain US keycodes the "ru" layout maps to
// the 4 missing letters - GRAVE->E, LBKT->X, RBKT->Ъ, APOS->Э - the same
// way a physical Russian keyboard's [, ], ' and ` keys do. The bottom row's
// outer columns get MINUS (left, same "-" in both groups) and Shift+SLASH
// (right, real comma - the plain COMMA keycode types "б" under "ru", since
// xkb maps it to Cyrillic_be; verified with
// `xkbcli compile-keymap --layout us,ru --options grp:alt_shift_toggle`).
//
// Home row also gets the same mod-taps as Base, keyed by physical column
// rather than letter (GUI/ALT/CTRL/SHIFT in, plain, plain, SHIFT/CTRL/ALT/GUI
// out) so held shortcuts like Ctrl+C work the same regardless of layer.

U_MACRO(rus_toggle, bindings = <&tog 10>, <&kp LA(LSHIFT)>;)

&{/keymap} {
    RUS {
        display-name = "Rus";
        bindings = <
&kp GRAVE  &kp Q  &kp W  &kp E  &kp R  &kp T       &kp Y  &kp U  &kp I     &kp O    &kp P     &kp LBKT \
&kp RBKT   U_MT(LGUI, A) U_MT(LALT, S) U_MT(LCTRL, D) U_MT(LSHFT, F) &kp G       &kp H  U_MT(LSHFT, J) U_MT(LCTRL, K) U_MT(LALT, L) U_MT(LGUI, SEMI)  &kp APOS \
&kp MINUS  &kp Z  &kp X  &kp C  &kp V  &kp B       &kp N  &kp M  &kp COMMA &kp DOT  &kp FSLH  &kp LS(FSLH) \
                          &trans &trans &trans      &trans &trans &trans   &trans
        >;
    };
};

/ {
    combos {
        compatible = "zmk,combos";
        combo_rus_toggle {
            timeout-ms = <50>;
            key-positions = <13 36>; // A (left pinky) + spare left thumb key
            // No `layers` property = layer_mask 0 = active on every layer
            // (this ZMK version's combo.c can't fold BIT(-1) into a
            // compile-time constant, so the documented `<-1>` spelling for
            // "all layers" fails to build; omitting the property reaches
            // the same `!combo->layer_mask` code path).
            bindings = <&rus_toggle>;
        };

        // Punctuation that's a single easy keystroke on Base/Latin but
        // buried behind Num+Shift+<digit> on RUS - Base's "?", "\"" and ";"
        // ride on the Colemak/QWERTY mapping, which doesn't carry over to
        // the "ru" xkb group. Each combo pairs the spare right thumb key
        // (position 43, otherwise idle) with whichever position holds that
        // symbol on Base, so the second key doubles as a mnemonic. They
        // send the literal Shift+<digit> HID keycode the "ru" group maps to
        // the desired glyph (verified with `xkbcli compile-keymap --layout
        // us,ru --options grp:alt_shift_toggle`) - only meaningful while RUS
        // is toggled on, since under the "us" group the same digit position
        // maps to something else entirely.
        combo_rus_question {
            timeout-ms = <50>;
            key-positions = <34 43>; // Base's "/" (Shift+/ = "?" on Base) + spare right thumb
            bindings = <&kp LS(N7)>; // Shift+7 = "?" under "ru"
        };
        combo_rus_quote {
            timeout-ms = <50>;
            key-positions = <9 43>; // Base's "'" (Shift+' = "\"" on Base) + spare right thumb
            bindings = <&kp LS(N2)>; // Shift+2 = "\"" under "ru"
        };
        combo_rus_semi {
            timeout-ms = <50>;
            key-positions = <35 43>; // Base's ";" key + spare right thumb
            bindings = <&kp LS(N4)>; // Shift+4 = ";" under "ru"
        };
    };
};

// Fill the outer-pinky-column positions Miryoku's own mapping always leaves
// as &none with punctuation that's frequent enough to want on the base
// layer without a trip through Sym - brackets on the top row, parens on the
// home row, minus/underscore at the bottom (comma is already reachable via
// the regular Colemak position, so it isn't duplicated here). Also bakes
// in the non-flip thumb order
// (Media/Nav/Mouse left, Sym/Num/Fun right) matching custom_config.h's
// MIRYOKU_NAV_VI (no MIRYOKU_LAYERS_FLIP). Since this restates the whole
// 44-key array for BASE, everything below matches what mapping/44/fuji44.h
// + MIRYOKU_ALTERNATIVES_BASE_COLEMAK already generate, with those 5 XXX
// positions and the thumb layer-taps filled in.
&{/keymap} {
    BASE {
        bindings = <
&kp LBKT  &kp Q             &kp W             &kp F  &kp P  &kp G               &kp J  &kp L             &kp U             &kp Y  &kp SQT              &kp RBKT \
&kp LPAR  U_MT(LGUI, A)     U_MT(LALT, R)     U_MT(LCTRL, S)    U_MT(LSHFT, T)    &kp D               &kp H  U_MT(LSHFT, N)    U_MT(LCTRL, E)    U_MT(LALT, I)     U_MT(LGUI, O)  &kp RPAR \
&kp MINUS U_LT(U_BUTTON, Z) U_MT(RALT, X)     &kp C  &kp V  &kp B               &kp K  &kp M             &kp COMMA         U_MT(RALT, DOT)   U_LT(U_BUTTON, SLASH)  &kp SEMI \
                  XXX  U_LT(U_MEDIA, ESC) U_LT(U_NAV, SPACE) U_LT(U_MOUSE, TAB)    U_LT(U_SYM, RET) U_LT(U_NUM, BSPC) U_LT(U_FUN, DEL)   XXX
        >;
    };
};
